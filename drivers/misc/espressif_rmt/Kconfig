## drivers/misc/espressif_rmt/Kconfig
```kconfig
# SPDX-FileCopyrightText: Copyright The Zephyr Project Contributors
# SPDX-License-Identifier: Apache-2.0

menuconfig ESPRESSIF_RMT
	bool "ESP32 RMT driver"
	default y
	depends on DT_HAS_ESPRESSIF_ESP32_RMT_ENABLED
	select DMA if DT_HAS_ESPRESSIF_ESP32_GDMA_ENABLED && SOC_SERIES_ESP32S3
	help
	  Enables the ESP32 Remote Control Transceiver driver.

if ESPRESSIF_RMT

config ESPRESSIF_RMT_INIT_PRIORITY
	int "ESP32 RMT driver init priority"
	default KERNEL_INIT_PRIORITY_DEVICE
	help
	  ESP32 RMT driver initialization priority in POST_KERNEL.

config ESPRESSIF_RMT_ISR_IRAM_SAFE
	bool "RMT ISR IRAM-Safe"
	help
	  Ensure the RMT interrupt is IRAM-Safe by allowing the interrupt handler to be
	  executable when the cache is disabled (e.g. SPI Flash write).

config ESPRESSIF_RMT_PM
	bool "Support for power management"
	help
	  If enabled, RMT driver is compiled with support for power management.

module = ESPRESSIF_RMT
module-str = espressif_rmt
source "subsys/logging/Kconfig.template.log_config"

endif
```

## dts/bindings/misc/espressif,esp32-rmt-device.yaml
```yaml
# SPDX-FileCopyrightText: Copyright The Zephyr Project Contributors
# SPDX-License-Identifier: Apache-2.0

# Common fields for Espressif RMT devices

include: [base.yaml, pinctrl-device.yaml, power.yaml]

on-bus: "espressif,esp32-rmt"

properties:
  reg:
    required: true

  pinctrl-0:
    required: true

  pinctrl-names:
    required: true

  with-dma:
    type: boolean
    description: |
      If set, the driver will allocate an RMT channel with DMA capability.
      DMA feature is available only on ESP32S3 and with only one "tx" and
      one "rx" DMA channels are available.
```

## dts/bindings/misc/espressif,esp32-rmt.yaml
```yaml
# SPDX-FileCopyrightText: Copyright The Zephyr Project Contributors
# SPDX-License-Identifier: Apache-2.0

description: |
    Espressif Remote Control Transceiver (RMT)

    The RMT (Remote Control Transceiver) peripheral was designed to act as an infrared transceiver.
    However, due to the flexibility of its data format, RMT can be extended to a versatile and
    general-purpose transceiver, transmitting or receiving many other types of signals.

    DMA feature is available only on ESP32S3 and with only one "tx" and one "rx" DMA channels
    are available. DMA channels are optional. Using DMA channels is activated using "with-dma" flag
    in the RMT peripheral.

    Here is an example ESP32 configuration with a RMT device:

    rmt: rmt@60016000 {
        compatible = "espressif,esp32-rmt";
        #address-cells = <1>;
        #size-cells = <0>;
        reg = <0x60016000 0x1000>;
        dmas = <&dma 8>, <&dma 9>;
        dma-names = "rx", "tx";
        interrupts = <RMT_INTR_SOURCE IRQ_DEFAULT_PRIORITY 0>;
        interrupt-parent = <&intc>;
        clocks = <&clock ESP32_RMT_MODULE>;
        status = "okay";
    };

compatible: "espressif,esp32-rmt"

include: [base.yaml, pinctrl-device.yaml]

bus: "espressif,esp32-rmt"

properties:
  reg:
    required: true

  clocks:
    required: true

  interrupts:
    required: true

  interrupt-parent:
    required: true
```
